## drivers/input/touchscreen/chipone-tddi/Kconfig
```kconfig
#
# Chipone Touchscreen driver configuration
#

config TOUCHSCREEN_CHIPONE
        bool "Chipone Touchscreen"
		depends on I2C
		default n
		help
		  Say Y here if you have Chipone touch panel.
		  If unsure, say N.

config TOUCHSCREEN_CHIPONE_DIRECTORY
    string "Chipone ts directory name"
    default "Chipone_touch"
    depends on TOUCHSCREEN_CHIPONE
```
